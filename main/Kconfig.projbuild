## main/Kconfig.projbuild
```kconfig
menu "Project configuration"

config PROJECT_WIFI_ENABLE
    bool "Enable WiFi"
    help
        Enable WiFi

config PROJECT_WIFI_SSID
    string "SSID"
    default ""
    depends on PROJECT_WIFI_ENABLE

config PROJECT_WIFI_PASSWORD
    string "Password"
    default ""
    depends on PROJECT_WIFI_ENABLE

config PROJECT_SNTP_ENABLE
    bool "Enable SNTP sync"
    depends on PROJECT_WIFI_ENABLE
    help
        Enable SNTP sync on boot

config PROJECT_SNTP_HOST
    string "SNTP hostname to sync with"
    default "pool.ntp.org"
    depends on PROJECT_SNTP_ENABLE
    help
        SNTP server to sync time with.

config PROJECT_DEEP_SLEEP_TIME_SEC
    int "Second to sleep"
    default 30

endmenu
```
